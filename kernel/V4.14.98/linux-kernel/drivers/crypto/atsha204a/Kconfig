## kernel/V4.14.98/linux-kernel/drivers/crypto/atsha204a/Kconfig
```kconfig
menuconfig CRYPTO_ATSHA204A_SUPPORT
	bool "ATSHA204A Crypto Support"
	default y
	help
	  ATSHA204A Crypto IC Support.
```

## uboot/mx7ulp_ai_m4boot_defconfig
```kconfig
CONFIG_ARM=y
CONFIG_ARCH_MX7ULP=y
CONFIG_TARGET_MX7ULP_AI=y
CONFIG_DEFAULT_DEVICE_TREE="imx7ulp-ai-qspi"
CONFIG_SYS_EXTRA_OPTIONS="IMX_CONFIG=board/freescale/mx7ulp_ai/imximage.cfg"
CONFIG_BOARD_LATE_INIT=y
CONFIG_BOARD_EARLY_INIT_F=y
CONFIG_HUSH_PARSER=y
CONFIG_OF_CONTROL=y
CONFIG_DM=y
CONFIG_DM_GPIO=y
CONFIG_IMX_RGPIO2P=y
CONFIG_DM_I2C=y
CONFIG_SYS_I2C_IMX_LPI2C=y
CONFIG_PINCTRL=y
CONFIG_PINCTRL_IMX7ULP=y
CONFIG_DM_SERIAL=y
CONFIG_FSL_LPUART=y
CONFIG_REQUIRE_SERIAL_CONSOLE=y
CONFIG_SERIAL_PRESENT=y
CONFIG_SPL_SERIAL_PRESENT=y
CONFIG_CMD_MMC=y
CONFIG_DM_MMC=y
# CONFIG_DM_MMC_OPS is not set
# CONFIG_BLK is not set
CONFIG_DM_REGULATOR=y
CONFIG_DM_REGULATOR_FIXED=y
CONFIG_DM_REGULATOR_GPIO=y
CONFIG_CMD_SF=y
CONFIG_FSL_QSPI=y
CONFIG_DM_SPI=y
CONFIG_DM_SPI_FLASH=y
CONFIG_SPI_FLASH=y
CONFIG_SPI_FLASH_MACRONIX=y
CONFIG_ULP_WATCHDOG=y
CONFIG_IMX_M4_BIND=y
CONFIG_DOS_PARTITION=y
CONFIG_CMD_NET=n
CONFIG_CMD_FPGA=n
CONFIG_CMD_NFS=n
CONFIG_BOOTDELAY=0
```
